## source/linux-2.6.36.x/drivers/ctrl/Kconfig
```kconfig
#
# Test device configuration
#

#menuconfig Mobile_Ctrl

#if Mobile_Ctrl

config GPIO_MOBILE_CTRL
	def_bool y
#	bool "Mobile Driver"
#	default y

#endif
```
